## conf/conf/layer.conf
```bitbake
# We have a conf and classes directory, add to BBPATH
BBPATH .= ":${LAYERDIR}"

# We have recipes-* directories, add to BBFILES
BBFILES += "${LAYERDIR}/recipes-*/*/*.bb \
            ${LAYERDIR}/recipes-*/*/*.bbappend"

BBFILE_COLLECTIONS += "meta-variscite-qemu"
BBFILE_PATTERN_meta-variscite-qemu = "^${LAYERDIR}/"
BBFILE_PRIORITY_meta-variscite-qemu = "9"
LAYERVERSION_meta-variscite-qemu = "1"
LAYERSERIES_COMPAT_meta-variscite-qemu = "kirkstone"
```
